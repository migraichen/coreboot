## payloads/external/barebox/Kconfig
```kconfig
if PAYLOAD_BAREBOX

config PAYLOAD_CONFIGFILE
	string "barebox config file"
	default ""
	help
	  This option allows a platform to set Kconfig options for a basic
	  barebox payload. In general, if the option is used, the default
	  would be "$(top)/src/mainboard/$(MAINBOARDDIR)/config_barebox"
	  for a config stored in the coreboot mainboard directory, or
	  "$(project_dir)/configs/coreboot-x86_defconfig" to use a config
	  from the barebox config directory

config PAYLOAD_FILE
	default "payloads/external/barebox/build/barebox"

endif
```

## payloads/external/barebox/Kconfig.name
```kconfig
config PAYLOAD_BAREBOX
	bool "barebox"
	depends on ARCH_X86
	help
	  Select this option if you want to build a coreboot image
	  with a barebox payload.

	  See https://doc.coreboot.org/payloads.html and barebox's documentation
	  at https://www.barebox.org for more information.
```
